## conductor/config/boards/shields/monokey/Kconfig.defconfig
```kconfig
if SHIELD_MONOKEY_R

config ZMK_KEYBOARD_NAME
    default "monokey_R"

config ZMK_SPLIT
    default y

config ZMK_SPLIT_ROLE_CENTRAL
    default n

endif

if SHIELD_MONOKEY_L

config ZMK_KEYBOARD_NAME
    default "monokey_L"

config ZMK_SPLIT
    default y

config ZMK_SPLIT_ROLE_CENTRAL
    default n

endif
```

## conductor/vendor/monograph-AML/config/boards/shields/monokey/Kconfig.defconfig
```kconfig
if SHIELD_MONOKEY_R

config ZMK_KEYBOARD_NAME
    default "monokey_R"

config ZMK_SPLIT
    default y

config ZMK_SPLIT_ROLE_CENTRAL
    default y

endif

if SHIELD_MONOKEY_L

config ZMK_KEYBOARD_NAME
    default "monokey_L"

config ZMK_SPLIT
    default y


endif
```

## conductor/vendor/monograph-AML/config/boards/shields/monokey/Kconfig.shield
```kconfig
config SHIELD_MONOKEY_R
    def_bool $(shields_list_contains,monokey_R)

config SHIELD_MONOKEY_L
    def_bool $(shields_list_contains,monokey_L)
```

## config/boards/shields/monokey/Kconfig.shield
```kconfig
config SHIELD_MONOKEY_R
    def_bool $(shields_list_contains,monokey_R)

config SHIELD_MONOKEY_L
    def_bool $(shields_list_contains,monokey_L)

config SHIELD_MONOKEY_DONGLE
    def_bool $(shields_list_contains,monokey_dongle)
```

## config/west.yml
```yaml
manifest:
  remotes:
    - name: zmkfirmware
      url-base: https://github.com/zmkfirmware
    - name: badjeff
      url-base: https://github.com/badjeff
    - name: caksoylar
      url-base: https://github.com/caksoylar
    - name: 4mplelab
      url-base: https://github.com/4mplelab

  projects:
    - name: zmk
      remote: zmkfirmware
      revision: main
      import: app/west.yml
    - name: zmk-pmw3610-driver
      remote: badjeff
      revision: main
    - name: zmk-rgbled-widget
      remote: caksoylar
      revision: main
    - name: zmk-feature-charge-indicator
      remote: 4mplelab
      revision: main
```
