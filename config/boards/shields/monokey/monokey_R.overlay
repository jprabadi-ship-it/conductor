#include <zephyr/dt-bindings/input/input-event-codes.h>
#include <dt-bindings/pinctrl/nrf-pinctrl.h>
#include "monokey.dtsi"

&default_transform {
    col-offset = <6>;
};

&xiao_serial { status = "disabled"; };

/* キーボード配線のみ残す */
&kscan0 {
    col-gpios
        = <&xiao_d 10 GPIO_ACTIVE_HIGH>
        , <&xiao_d 9 GPIO_ACTIVE_HIGH> 
        , <&xiao_d 8 GPIO_ACTIVE_HIGH> 
        , <&xiao_d 7 GPIO_ACTIVE_HIGH> 
        , <&gpio0 10 GPIO_ACTIVE_HIGH>
        ;
};

/* ⚠️ トラックボールの設定（&spi0 や trackball_listener）をこのファイルから完全に削除します */
